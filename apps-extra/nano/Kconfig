## configs/nuttx-minimal.defconfig
```kconfig
#
# ESP32-S3 NuttX 最小配置 (无需外部下载)
# NuttX 12.12.0 + ESP-IDF v5.5.4
#

# ===== 架构 =====
CONFIG_ARCH="xtensa"
CONFIG_ARCH_XTENSA=y
CONFIG_ARCH_BOARD="esp32s3-devkit"
CONFIG_ARCH_BOARD_COMMON=y
CONFIG_ARCH_BOARD_ESP32S3_DEVKIT=y
CONFIG_ARCH_CHIP="esp32s3"
CONFIG_ARCH_CHIP_ESPRESSIF=y
CONFIG_ARCH_CHIP_ESP32S3=y
CONFIG_ESPRESSIF_CHIP_SERIES=esp32s3
CONFIG_ARCH_FAMILY_LX7=y
CONFIG_XTENSA_TOOLCHAIN_ESP=y

# ===== Boot Format =====
CONFIG_ESPRESSIF_SIMPLE_BOOT=y

# ===== Idle Thread =====
CONFIG_IDLETHREAD_STACKSIZE=2048

# ===== Flash Timing =====
CONFIG_ESP32S3_FLASH_FREQ_40M=y

# CPU 配置
CONFIG_ESP32S3_CPU_FREQ_240=y
CONFIG_BOARD_LOOPS_PER_SEC=240000000
CONFIG_BOARD_LOOPSPERMSEC=16717

# 双核 SMP
CONFIG_SMP=y
CONFIG_SMP_NCPUS=2
CONFIG_SPINLOCK=y
CONFIG_SCHED_CPULOAD=y
CONFIG_ARCH_HAVE_TESTSET=y

# Flash & PSRAM
CONFIG_ESP32S3_FLASH_16MB=y
CONFIG_ESP32S3_FLASH_SIZE="16MB"
CONFIG_ESP32S3_PSRAM_8MB=y
CONFIG_ESP32S3_PSRAM_SIZE="8MB"
CONFIG_SPIRAM=y

# NuttX 内核
CONFIG_NUTTX=y
CONFIG_VERSION_STRING="12.12.0"
CONFIG_INIT_ENTRYPOINT="nsh_main"
CONFIG_STACK_USAGE_WARNING=0

# 系统
CONFIG_SYS_USR=y
CONFIG_SYSTEM_NSH=y
CONFIG_SYSTEM_NSH_CXX=y
CONFIG_NSH_READLINE=y
CONFIG_NSH_LINELEN=256
CONFIG_NSH_PROMPT_MAX=64

# 文件系统 (禁用 littlefs)
CONFIG_FS_FAT=y
CONFIG_FAT_LFN=y
CONFIG_FS_PROCFS=y

# 网络 (简化)
CONFIG_NET=y
CONFIG_NET_TCP=y
CONFIG_NET_UDP=y
CONFIG_NET_ICMP=y

# 驱动
CONFIG_I2C=y
CONFIG_I2C_DRIVER=y
CONFIG_SPI=y
CONFIG_WATCHDOG=y
CONFIG_WDT=y
CONFIG_ESP32S3_WDT=y
CONFIG_RTC=y
CONFIG_RTC_DRIVER=y
CONFIG_RTC_FUNCTIONS=y

# C 库
CONFIG_LIBC_FLOATINGPOINT=y

# 调试 (最小化 - 仅错误和警告)
CONFIG_DEBUG_FEATURES=y
CONFIG_DEBUG_ERROR=y
CONFIG_DEBUG_WARN=y

# 构建
CONFIG_HOST_LINUX=y
CONFIG_BUILD_FLAT=y
CONFIG_RAW_BINARY=y
CONFIG_HAVE_LONG_LONG=y

# 工具链
CONFIG_ARCH_TOOLCHAIN_GNU=y

# 调度
CONFIG_RR_INTERVAL=200
```

## src/nuttx/esp32/Kconfig.esp32
```kconfig
#
# ESP32-CAM NuttX Kconfig - Menuconfig 配置
#

config ESP32_RETRO
    bool "ESP32-CAM 复古图形工作站"
    select ESP32
    help
      启用 ESP32-CAM 复古图形工作站支持

if ESP32_RETRO

config RETRO_ARCH
    string
    default "xtensa-esp32"
    help
      本目标架构标识（.rpk 包 Arch 匹配用：<family>-<chip>）。

config RETRO_PKG_MANAGER
    bool ".rpk 包管理器（deb 风格）"
    default y
    help
      NSH pkg install/remove/list/info 命令（pkg_manager.c）。
      RISC-V 与 Xtensa 包经 Arch 字段隔离，防止误装。

config RETRO_GPIO_SCRIPT
    bool "脚本引擎 GPIO/ADC/PWM 接口（教学）"
    default y
    help
      各脚本引擎（bas/js/berry/py）经 retro_gpio 统一接口操作 GPIO。
      系统占用引脚（各板硬件档案占用表）访问时直接报"已占用"返回 -EBUSY。

config RETRO_DISPLAY
    bool "CVBS 显示驱动 (DAC 模式)"
    default y
    help
      启用 CVBS AV 输出驱动（使用 ESP32 内置 DAC）

config RETRO_CVBS_DAC
    bool "使用内置 DAC 输出 CVBS"
    default y
    depends on RETRO_DISPLAY
    help
      使用 ESP32 内置 DAC (GPIO25) 输出 CVBS 复合视频

if RETRO_DISPLAY

config RETRO_DISPLAY_WIDTH
    int "显示宽度"
    default 640
    range 320 720
    help
      水平分辨率（CVBS 最大 720）

config RETRO_DISPLAY_HEIGHT
    int "显示高度"
    default 480
    range 240 576
    help
      垂直分辨率（PAL 576, NTSC 480）

config RETRO_DISPLAY_REFR_RATE
    int "刷新率(Hz)"
    default 50
    range 25 60
    help
      PAL 50Hz, NTSC 60Hz

config RETRO_DISPLAY_PALETTE_SIZE
    int "调色板颜色数"
    default 256
    range 2 256
    help
      256色调色板

choice
    prompt "桌面外壳风格"
    default RETRO_DESKTOP_SHELL_WIN3
    help
      图形桌面外观：Windows 3.2 任务栏风格（默认）或
      WindowMaker/NeXT 风格（右侧 Dock + 桌面点击弹出根菜单）。
      运行时可用 NSH 命令切换: shell win3 | shell wmaker

config RETRO_DESKTOP_SHELL_WIN3
    bool "Windows 3.2 风格（默认）"

config RETRO_DESKTOP_SHELL_WMAKER
    bool "WindowMaker/NeXT 风格（Dock + 根菜单）"

endchoice

endif # RETRO_DISPLAY

config RETRO_AUDIO
    bool "音频驱动 (DAC 模式)"
    default y
    help
      启用 DAC 音频驱动（使用 ESP32 内置 DAC）

config RETRO_AUDIO_DAC
    bool "使用内置 DAC 输出音频"
    default y
    depends on RETRO_AUDIO
    help
      使用 ESP32 内置 DAC (GPIO26) 输出模拟音频

if RETRO_AUDIO

config RETRO_AUDIO_I2S
    int "I2S 端口"
    default 0
    range 0 1
    help
      I2S 端口号（DAC 模式下使用 I2S0）

config RETRO_AUDIO_SAMPLE_RATE
    int "采样率"
    default 44100
    range 8000 48000

endif # RETRO_AUDIO

config RETRO_INPUT_BLE_HID
    bool "BLE HID 输入（键盘/鼠标）"
    default y
    help
      使用 BLE HID 连接蓝牙键盘和鼠标

if RETRO_INPUT_BLE_HID

config RETRO_BLE_MAX_BOND
    int "最大配对设备数"
    default 3
    range 1 5
    help
      最多存储的配对设备数量

config RETRO_BLE_DEVICE_NAME
    string "BLE 设备名称"
    default "ESP32-CAM"
    help
      BLE 广播时的设备名称

config RETRO_BLE_AUTO_CONNECT
    bool "启动时自动连接"
    default y
    help
      上电时自动连接已配对设备

config RETRO_BLE_SCAN_TIMEOUT
    int "扫描超时(秒)"
    default 10
    range 5 30
    help
      扫描 HID 设备的超时时间

config RETRO_BLE_LED_PIN
    int "状态 LED 引脚"
    default 4
    help
      ESP32-CAM BLE 状态 LED 引脚。
      4 = Flash LED (板载唯一 LED，用于蓝牙状态指示)
      注意：使用此引脚后，拍照闪光灯功能将被蓝牙指示灯占用

endif # RETRO_INPUT_BLE_HID

config RETRO_RTC_I2C_SDA
    int "RTC I2C SDA 引脚"
    default 21
    help
      ESP32-CAM RTC I2C SDA 引脚。
      推荐使用 GPIO21 (SDA) / GPIO22 (SCL)，这是 ESP32 默认 I2C 引脚。

config RETRO_RTC_I2C_SCL
    int "RTC I2C SCL 引脚"
    default 22
    help
      ESP32-CAM RTC I2C SCL 引脚

config RETRO_FSK
    bool "FSK 磁带调制解调"
    default y
    help
      启用 FSK 磁带调制解调器

if RETRO_FSK

config RETRO_FSK_BAUD
    int "FSK 码速率"
    default 4800
    range 300 9600
    help
      波特率（默认 4800）

config RETRO_FSK_LOGIC0_FREQ
    int "逻辑0频率(Hz)"
    default 4800
    help
      FSK 逻辑0频率

config RETRO_FSK_LOGIC1_FREQ
    int "逻辑1频率(Hz)"
    default 9600
    help
      FSK 逻辑1频率

endif # RETRO_FSK

config RETRO_RTC
    bool "RTC 时钟支持"
    default n
    help
      启用 RTC 外置时钟芯片支持

if RETRO_RTC

config RETRO_RTC_CHIP
    string "RTC 芯片型号"
    default "ds1307"
    help
      支持: ds1307, ds1338, pcf8563, rv3028

endif # RETRO_RTC

config RETRO_WIFI
    bool "WiFi 支持"
    default y
    help
      启用 WiFi 网络

if RETRO_WIFI

config RETRO_WIFI_SSID
    string "WiFi SSID"
    default ""
    help
      WiFi 名称

config RETRO_WIFI_PASSWORD
    string "WiFi 密码"
    default ""
    help
      WiFi 密码

endif # RETRO_WIFI

config RETRO_SCRIPTS
    bool "脚本引擎支持"
    default y
    help
      启用脚本引擎框架（每种引擎均可独立勾选编译嵌入）。
      ESP32-CAM (4MB Flash) 不提供 CPython 选项——容量不足
      （2026-04-02 已验证移除，见 BUILD_FIXES.md）。

if RETRO_SCRIPTS

config RETRO_SCRIPT_TINYBASIC
    bool "my-basic (BASIC)"
    default y
    help
      启用 my-basic 解释器（.bas，约 128KB 内存）

config RETRO_SCRIPT_DUKTAPE
    bool "Duktape (JavaScript ES5)"
    default y
    help
      启用 Duktape JavaScript 引擎（.js，约 384KB 内存）

config RETRO_SCRIPT_BERRY
    bool "Berry (类 Python 轻量语言)"
    default n
    help
      启用 Berry 解释器（.be，内核 <40KB ROM、<4KB 堆，CAM 也可用）。
      依赖 nuttx-apps interpreters/berry（构建时自动拉取固定版本）。

config RETRO_LOGO_JSLOGO
    bool "jslogo (UCBLogo 子集，跑在 Duktape 上)"
    default n
    depends on RETRO_SCRIPT_DUKTAPE
    help
      启用 jslogo 海龟画图（.lgo，Apache-2.0，UCBLogo 子集）。
      解释器 JS 源码由 download_deps.sh 下载到 deps/jslogo，
      运行时从 /sdcard/scripts/logo/lib/ 加载；绘图走 LVGL 后端。

endif # RETRO_SCRIPTS

config RETRO_NTP
    bool "NTP 时间同步"
    default y
    help
      启用 NTP 自动对时

if RETRO_NTP

config RETRO_NTP_SERVER
    string "NTP 服务器"
    default "ntp.aliyun.com"
    help
      NTP 服务器地址

endif # RETRO_NTP

config RETRO_CRON
    bool "Cron 定时任务"
    default y
    help
      启用 Cron 定时任务

endif # ESP32_RETRO
```

## src/nuttx/esp32c3/Kconfig.esp32c3
```kconfig
#
# SPDX-FileCopyrightText: 2026 ESP32-S3 Retro Project
# SPDX-License-Identifier: Apache-2.0
#
# WHAT : ESP32-C3 目标（合宙核心板，CLI 工作站）menuconfig 配置
# WHY  : 低资源/低价格第三目标；RISC-V 架构，纯 CLI + .rpk 包管理器
# WHO  : NuttX Kconfig 系统扫描
# WHERE: retro-ws/src/nuttx/esp32c3/Kconfig.esp32c3
# WHEN : 2026-10-04 新增
# HOW  : RETRO_ARCH 供 pkg_manager 做包架构匹配；无 LVGL/CPython 选项
#

config ESP32C3_RETRO
    bool "合宙 ESP32-C3 核心板复古 CLI 工作站"
    select ARCH_CHIP_ESP32C3
    help
      启用合宙 ESP32-C3 核心板支持（经典款 CH343 / 简约款原生 USB）

if ESP32C3_RETRO

config RETRO_ARCH
    string
    default "riscv-esp32c3"
    help
      本目标架构标识（.rpk 包 Arch 匹配用：<family>-<chip>）。
      包 Arch 取值 all / riscv / xtensa / esp32c3 / esp32s3 / esp32。

choice
    prompt "核心板版本（控制台通道）"
    default RETRO_LUATOS_C3_UARTBRIDGE
    help
      经典款：板载 CH343 USB 转串口（UART0 控制台）。
      简约款：无串口芯片，Type-C 直连原生 USB（USB-Serial-JTAG）。

config RETRO_LUATOS_C3_UARTBRIDGE
    bool "经典款（CH343 串口芯片）"

config RETRO_LUATOS_C3_NATIVEUSB
    bool "简约款（原生 USB，无串口芯片）"

endchoice

config RETRO_SCRIPTS
    bool "脚本引擎支持"
    default y
    help
      CLI 脚本引擎（无 LVGL，retro_ui 胶水层不可用）：
      my-basic 与 Berry 均可运行于 400KB SRAM。

if RETRO_SCRIPTS

config RETRO_SCRIPT_TINYBASIC
    bool "my-basic (BASIC)"
    default y
    help
      启用 my-basic 解释器（.bas）

config RETRO_SCRIPT_BERRY
    bool "Berry (类 Python 轻量语言)"
    default n
    help
      启用 Berry 解释器（.be，内核 <40KB ROM、<4KB 堆）。
      CLI 模式下 retro_ui_* 函数退化为 printf 输出。

endif # RETRO_SCRIPTS

config RETRO_PKG_MANAGER
    bool ".rpk 包管理器（deb 风格）"
    default y
    help
      NSH pkg install/remove/list/info 命令（pkg_manager.c）。
      低资源目标的软件交付主通道；RISC-V 包经 Arch 字段与 Xtensa 隔离。

config RETRO_GPIO_SCRIPT
    bool "脚本引擎 GPIO/ADC/PWM 接口（教学）"
    default y
    help
      各脚本引擎（bas/js/berry/py）经 retro_gpio 统一接口操作 GPIO。
      系统占用引脚（各板硬件档案占用表）访问时直接报"已占用"返回 -EBUSY。

endif # ESP32C3_RETRO
```

## src/nuttx/esp32s3/Kconfig
```kconfig
#
# ESP32-S3 NuttX Kconfig - Menuconfig 配置
#

config ESP32_RETRO
    bool "ESP32-S3 复古图形工作站"
    select ESP32S3
    select ESP32S3_Kconfig
    help
      启用 ESP32-S3 复古图形工作站支持

if ESP32_RETRO

config RETRO_ARCH
    string
    default "xtensa-esp32s3"
    help
      本目标架构标识（.rpk 包 Arch 匹配用：<family>-<chip>）。

config RETRO_PKG_MANAGER
    bool ".rpk 包管理器（deb 风格）"
    default y
    help
      NSH pkg install/remove/list/info 命令（pkg_manager.c）。
      RISC-V 与 Xtensa 包经 Arch 字段隔离，防止误装。

config RETRO_GPIO_SCRIPT
    bool "脚本引擎 GPIO/ADC/PWM 接口（教学）"
    default y
    help
      各脚本引擎（bas/js/berry/py）经 retro_gpio 统一接口操作 GPIO。
      系统占用引脚（各板硬件档案占用表）访问时直接报"已占用"返回 -EBUSY。

config RETRO_DEVKITC_V10
    bool "ESP32-S3-DevKitC-1 v1.0 板本（LED=GPIO48）"
    default n
    help
      v1.0 板载 WS2812 RGB LED 接 GPIO48；v1.1（默认）接 GPIO38。
      按板丝印版本选择，详见 HARDWARE.md 2.8 节。

config RETRO_FLASH_8MB
    bool "N8R8 模组（8MB Flash）"
    default n
    help
      N16R8（默认 16MB Flash）/ N8R8（8MB Flash）引脚一致，
      仅分区表布局不同。详见 HARDWARE.md 1.1 节。

config RETRO_DISPLAY
    bool "CVBS 显示驱动"
    default y
    help
      启用 CVBS AV 输出驱动

if RETRO_DISPLAY

config RETRO_DISPLAY_WIDTH
    int "显示宽度"
    default 640
    range 320 1280
    help
      水平分辨率

config RETRO_DISPLAY_HEIGHT
    int "显示高度"
    default 480
    range 240 768
    help
      垂直分辨率

config RETRO_DISPLAY_REFR_RATE
    int "刷新率(Hz)"
    default 60
    range 25 60
    help
      帧率（帧重复降刷新）

config RETRO_DISPLAY_PALETTE_SIZE
    int "调色板颜色数"
    default 256
    range 2 256
    help
      256色调色板

choice
    prompt "桌面外壳风格"
    default RETRO_DESKTOP_SHELL_WIN3
    help
      图形桌面外观：Windows 3.2 任务栏风格（默认）或
      WindowMaker/NeXT 风格（右侧 Dock + 桌面点击弹出根菜单）。
      运行时可用 NSH 命令切换: shell win3 | shell wmaker

config RETRO_DESKTOP_SHELL_WIN3
    bool "Windows 3.2 风格（默认）"

config RETRO_DESKTOP_SHELL_WMAKER
    bool "WindowMaker/NeXT 风格（Dock + 根菜单）"

endchoice

config RETRO_CVBS
    bool "CVBS 硬件输出（I2S + 电阻网络）"
    default y
    depends on RETRO_DISPLAY
    help
      ESP32-S3 无内置 DAC：I2S+GDMA 以 13.5MHz 字节流
      经电阻网络输出 PAL 复合视频（行时序核心见
      src/nuttx/common/driver/cvbs_core.c，与宿主机
      模拟器共用同一份时序定义）

endif # RETRO_DISPLAY

config RETRO_MEMMON
    bool "内存水位监控"
    default y
    help
      80/90/95% 三级内存告警与紧急处置（AGENTS.md 10.2）

config RETRO_NET
    bool "网络工具（ping/ifconfig）"
    default y
    depends on NET
    help
      WiFi 连接管理与网络诊断命令

config RETRO_FIREWALL
    bool "入站防火墙（默认拒绝）"
    default n
    depends on RETRO_NET
    help
      规则表式入站过滤（当前为独立 API，接入网络栈见 NEXT_STEPS）

config RETRO_AUDIO
    bool "音频驱动"
    default y
    help
      启用 I2S DAC 音频驱动

if RETRO_AUDIO

config RETRO_AUDIO_I2S
    int "I2S 端口"
    default 0
    range 0 1
    help
      I2S 端口号

config RETRO_AUDIO_SAMPLE_RATE
    int "采样率"
    default 44100
    range 8000 48000

endif # RETRO_AUDIO

config RETRO_FSK
    bool "FSK 磁带调制解调"
    default y
    help
      启用 FSK 磁带调制解调器

if RETRO_FSK

config RETRO_FSK_BAUD
    int "FSK 码速率"
    default 4800
    range 300 9600
    help
      波特率（默认 4800）

config RETRO_FSK_LOGIC0_FREQ
    int "逻辑0频率(Hz)"
    default 4800
    help
      FSK 逻辑0频率

config RETRO_FSK_LOGIC1_FREQ
    int "逻辑1频率(Hz)"
    default 9600
    help
      FSK 逻辑1频率

endif # RETRO_FSK

config RETRO_RTC
    bool "RTC 时钟支持"
    default n
    help
      启用 RTC 外置时钟芯片支持

if RETRO_RTC

config RETRO_RTC_CHIP
    string "RTC 芯片型号"
    default "ds1307"
    help
      支持: ds1307, ds1338, pcf8563, rv3028

endif # RETRO_RTC

config RETRO_WIFI
    bool "WiFi 支持"
    default y
    help
      启用 WiFi 网络

if RETRO_WIFI

config RETRO_WIFI_SSID
    string "WiFi SSID"
    default ""
    help
      WiFi 名称

config RETRO_WIFI_PASSWORD
    string "WiFi 密码"
    default ""
    help
      WiFi 密码

endif # RETRO_WIFI

config RETRO_SCRIPTS
    bool "脚本引擎支持"
    default y
    help
      启用脚本引擎框架（每种引擎均可独立勾选编译嵌入）：
      my-basic / Duktape / Berry / CPython / jslogo

if RETRO_SCRIPTS

config RETRO_SCRIPT_TINYBASIC
    bool "my-basic (BASIC)"
    default y
    help
      启用 my-basic 解释器（.bas，约 128KB 内存）

config RETRO_SCRIPT_DUKTAPE
    bool "Duktape (JavaScript ES5)"
    default y
    help
      启用 Duktape JavaScript 引擎（.js，约 384KB 内存）

config RETRO_SCRIPT_BERRY
    bool "Berry (类 Python 轻量语言)"
    default n
    help
      启用 Berry 解释器（.be，内核 <40KB ROM、<4KB 堆，S3/CAM 通吃）。
      依赖 nuttx-apps interpreters/berry（构建时自动拉取固定版本）。

config RETRO_SCRIPT_PYTHON
    bool "CPython (完整 Python 3)"
    default n
    depends on !RETRO_FLASH_8MB
    help
      启用 CPython（.py，nuttx-apps interpreters/python）。
      仅 ESP32-S3 16MB Flash (N16R8) 可用——N8R8/CAM 容量不足。
      ROMFS 标准库镜像需按 NuttX 文档配置。

config RETRO_LOGO_JSLOGO
    bool "jslogo (UCBLogo 子集，跑在 Duktape 上)"
    default n
    depends on RETRO_SCRIPT_DUKTAPE
    help
      启用 jslogo 海龟画图（.lgo，Apache-2.0，UCBLogo 子集）。
      解释器 JS 源码由 download_deps.sh 下载到 deps/jslogo，
      运行时从 /sdcard/scripts/logo/lib/ 加载；绘图走 LVGL 后端。

endif # RETRO_SCRIPTS

config RETRO_NTP
    bool "NTP 时间同步"
    default y
    help
      启用 NTP 自动对时

if RETRO_NTP

config RETRO_NTP_SERVER
    string "NTP 服务器"
    default "ntp.aliyun.com"
    help
      NTP 服务器地址

endif # RETRO_NTP

config RETRO_CRON
    bool "Cron 定时任务"
    default y
    help
      启用 Cron 定时任务

endif # ESP32_RETRO
```

## src/nuttx/rp2040/Kconfig.rp2040
```kconfig
# SPDX-FileCopyrightText: 2026 ESP32-S3 Retro Project
# SPDX-License-Identifier: Apache-2.0
#
# rp2040 目标配置（第四目标：Pico 本地 CLI 终端，无网络）

menu "Retro WS RP2040 (Pico)"

config RP2040_RETRO
    bool "启用 Retro WS Pico 支持"
    default y
    help
      第四目标：本地 CLI 教学终端（无 CVBS/音频/网络）。

config RETRO_ARCH
    string
    default "arm-rp2040" if RP2040_RETRO

config RETRO_PKG_MANAGER
    bool ".rpk 包管理器"
    default y
    depends on RP2040_RETRO
    help
      CLI 侧 pkg install/remove/list（SD 卡安装源）。
      注意 arch=arm 的包与 xtensa/riscv 不通用。

config RETRO_GPIO_SCRIPT
    bool "脚本 GPIO 访问（占用拦截）"
    default y
    depends on RP2040_RETRO

config RETRO_SCRIPTS
    bool "脚本引擎"
    default y
    depends on RP2040_RETRO

if RETRO_SCRIPTS

config RETRO_SCRIPT_TINYBASIC
    bool "my-basic (BASIC)"
    default y

config RETRO_SCRIPT_DUKTAPE
    bool "Duktape (JavaScript)"
    default n
    help
      ~430KB；实测 2MB 装下字体+Berry+my-basic 后仍余 ~38%，按需开。

config RETRO_PINYIN_CLI
    bool "CLI 拼音输入法"
    default y

endif # RETRO_SCRIPTS

endmenu
```
